## CMakeLists.txt
```
cmake_minimum_required(VERSION 3.20)
set(SHIELD plant_sensors)
find_package(Zephyr REQUIRED HINTS $ENV{ZEPHYR_BASE})
project(sensors-smoke)
target_sources(app PRIVATE src/main.c)
```

## prj.conf
```kconfig
# Float formatting for snprintf (plant_json). In the product apps the
# plant-net snippet sets these two; this smoke app has no snippet.
CONFIG_PICOLIBC_IO_FLOAT=y
CONFIG_PLANT_JSON=y
```

## src/main.c
```c
/*
 * Bench smoke app for the plant_sensors shield and module.
 * Prints one sensor phase as a plant_json sensors/raw payload every 5 s.
 * Re-run on the bench after any change to the shield.
 */
#include <stdio.h>

#include <zephyr/kernel.h>

#include <plant/json.h>
#include <plant/sensors.h>

int main(void)
{
	struct plant_sensor_values v;
	char buf[PLANT_JSON_RAW_MAX];
	int ret = plant_sensors_init();

	printf("plant_sensors_init: %d\n", ret);

	for (;;) {
		int failed = plant_sensors_read(&v);
		int len = plant_json_encode_raw(&v, NULL, buf, sizeof(buf));

		printf("failed=%d valid=0x%02x %s\n", failed, v.valid,
		       len >= 0 ? buf : "(encode error)");
		k_sleep(K_SECONDS(5));
	}
	return 0;
}
```
