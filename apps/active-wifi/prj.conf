## CMakeLists.txt
```
cmake_minimum_required(VERSION 3.20)

# Shared modules (SM-04): sensor devicetree + calibration, and the network stack.
set(SHIELD plant_sensors)
set(SNIPPET plant-net)

# WiFi credentials and broker are local-only (gitignored); see credentials.conf.example.
# The publish interval comes from a committed fragment selected per condition:
#   west build -p always ... -- -DEXTRA_CONF_FILE=interval-60.conf
# Never pass -DCONFIG_... on the command line: CMake caches it and it silently
# overrides later builds.
if(EXISTS ${CMAKE_CURRENT_SOURCE_DIR}/credentials.conf)
  list(APPEND EXTRA_CONF_FILE ${CMAKE_CURRENT_SOURCE_DIR}/credentials.conf)
else()
  message(FATAL_ERROR "Missing credentials.conf: copy credentials.conf.example "
                      "to credentials.conf and fill in SSID, PSK and broker.")
endif()

find_package(Zephyr REQUIRED HINTS $ENV{ZEPHYR_BASE})
project(active-wifi)
target_sources(app PRIVATE src/main.c src/link.c)
```

## Kconfig
```
mainmenu "Comparison baseline A (active-wifi)"

config APP_PUBLISH_INTERVAL_S
	int "Publication interval (s), equal to main's read_interval_s"
	default 300
	range 10 86400
	help
	  Set per experiment condition with interval-60.conf / interval-300.conf
	  (FR-AW-03), never on the command line.

config APP_WIFI_SSID
	string "WiFi SSID"

config APP_WIFI_PSK
	string "WiFi PSK"

config APP_MQTT_BROKER
	string "MQTT broker host (IPv4 literal or DNS name)"

source "Kconfig.zephyr"
```

## prj.conf
```kconfig
# App-local symbols only. Sensor and network symbols come from the
# plant_sensors shield and the plant-net snippet (SM-05).
CONFIG_BT=n
CONFIG_PM=n
CONFIG_LOG=y
CONFIG_LOG_DEFAULT_LEVEL=2
```

## interval-300.conf
```kconfig
# Experiment condition: 300 s publication interval (main's default read_interval_s).
CONFIG_APP_PUBLISH_INTERVAL_S=300
```

## interval-60.conf
```kconfig
# Experiment condition: 60 s publication interval (literature sanity check).
CONFIG_APP_PUBLISH_INTERVAL_S=60
```

## src/main.c
```c
/* Comparison baseline A: the always-connected pattern from the literature
 * (spec 2026-04-05-active-wifi-firmware-design.md, ADR-0006).
 *
 * Connects once, then reads, publishes and waits on a fixed grid forever,
 * never sleeping (CONFIG_PM=n). Same sensor read, encoder and network stack
 * as apps/main; only the orchestration differs. One application thread.
 *
 * On a dropped connection it reconnects at once and skips the slots that fall
 * due meanwhile, still counting them (FR-AW-04): see link.h and slot.h. */
#include <errno.h>

#include <zephyr/kernel.h>
#include <zephyr/logging/log.h>

#include <plant/json.h>
#include <plant/net.h>
#include <plant/sensors.h>
#include <plant/types.h>

#include "link.h"
#include "slot.h"

LOG_MODULE_REGISTER(active_wifi, LOG_LEVEL_WRN);

#define DEVICE_NAME "baseline-a"
#define TOPIC_RAW "plants/" DEVICE_NAME "/sensors/raw"
#define TOPIC_STATUS "plants/" DEVICE_NAME "/status"

#define INTERVAL_MS ((int64_t)CONFIG_APP_PUBLISH_INTERVAL_S * 1000)

static const struct link_config link_cfg = {
	.ssid = CONFIG_APP_WIFI_SSID,
	.psk = CONFIG_APP_WIFI_PSK,
	.broker = CONFIG_APP_MQTT_BROKER,
	.client_id = DEVICE_NAME,
	.wifi_timeout_ms = 30000,
	.mqtt_timeout_ms = 10000,
	.sntp_timeout_ms = 10000,
};

static struct link net_link;

int64_t link_uptime_ms(void)
{
	return k_uptime_get();
}

/* Retry at once until MQTT is up: no backoff, no sleep (FR-AW-04). A failing
 * attempt is logged only when its error changes, to keep the serial quiet
 * during an outage (NFR-AW-02). */
static void connect_until_up(void)
{
	int last = 0;
	int ret;

	while ((ret = link_try_up(&net_link)) < 0) {
		if (ret != last) {
			LOG_WRN("reconnect failed: %d (retrying)", ret);
			last = ret;
		}
	}
}

/* Encode and publish one payload. Only a failed publish is an error: a
 * failed encode loses that payload but says nothing about the connection. */
static int publish(const char *topic, const char *payload, int len)
{
	int ret;

	if (len < 0) {
		LOG_WRN("encode %s failed: %d", topic, len);
		return 0;
	}
	ret = plant_mqtt_publish(topic, payload, (size_t)len);
	if (ret < 0) {
		LOG_WRN("publish %s failed: %d", topic, ret);
	}
	return ret;
}

/* One grid slot (FR-AW-01.4, FR-AW-02). cycle_count is the slot index.
 * Returns the publish error if the connection failed mid-slot. */
static int publish_slot(uint32_t slot)
{
	struct plant_sensor_values vals = {0};
	struct plant_status status = {0};
	char payload[MAX(PLANT_JSON_RAW_MAX, PLANT_JSON_STATUS_MAX)];
	int64_t ts_ms;
	bool have_ts = link_wall_clock_ms(&net_link, k_uptime_get(), &ts_ms);
	int16_t rssi;
	int ret;

	(void)plant_sensors_read(&vals);
	ret = publish(TOPIC_RAW, payload,
		      plant_json_encode_raw(&vals, have_ts ? &ts_ms : NULL, payload,
					    sizeof(payload)));
	if (ret < 0) {
		return ret;
	}

	status.cycle_count = slot;
	status.present = PLANT_STATUS_CYCLE_COUNT;
	if (plant_wifi_rssi(&rssi) == 0) {
		status.wifi_rssi_dbm = rssi;
		status.present |= PLANT_STATUS_WIFI_RSSI_DBM;
	}
	if (have_ts) {
		status.timestamp_ms = ts_ms;
		status.present |= PLANT_STATUS_TIMESTAMP_MS;
	}
	/* wake_reason and every t_*_ms stay null: they don't apply to baseline A. */
	return publish(TOPIC_STATUS, payload,
		       plant_json_encode_status(&status, payload, sizeof(payload)));
}

/* Keep the connection serviced until `due` (FR-AW-01.5). Returns -ENOTCONN as
 * soon as plant_mqtt_poll reports a dropped connection. */
static int wait_until(int64_t due)
{
	int64_t now;

	while ((now = k_uptime_get()) < due) {
		if (plant_mqtt_poll((int32_t)MIN(due - now, INT32_MAX)) == -ENOTCONN) {
			return -ENOTCONN;
		}
	}
	return 0;
}

int main(void)
{
	uint32_t slot = 0;
	int64_t t0;
	int64_t now_wall_ms;
	int ret;

	LOG_WRN("baseline-a: publish interval %d s", CONFIG_APP_PUBLISH_INTERVAL_S);

	ret = plant_sensors_init();
	if (ret < 0) {
		LOG_WRN("sensors init: %d (failed sensors publish null)", ret);
	}
	ret = plant_net_init();
	if (ret < 0) {
		LOG_ERR("plant_net_init failed: %d", ret);
		return ret;
	}

	link_init(&net_link, &link_cfg);
	connect_until_up();
	if (!link_wall_clock_ms(&net_link, k_uptime_get(), &now_wall_ms)) {
		LOG_WRN("sntp failed: timestamp_ms is null until reboot");
	}

	t0 = k_uptime_get();
	for (;;) {
		uint32_t resume_from = slot;
		bool dropped = true;

		/* A drop while waiting keeps this slot, which may still be on time.
		 * Once publishing starts the slot is used up, even if it fails. */
		if (wait_until(t0 + (int64_t)slot * INTERVAL_MS) == 0) {
			dropped = (publish_slot(slot) < 0);
			resume_from = slot + 1;
		}
		if (dropped) {
			LOG_WRN("connection dropped at slot %u", slot);
			connect_until_up();
		}
		/* The first slot not yet due: never late, never a burst. */
		slot = slot_next(t0, INTERVAL_MS, resume_from, k_uptime_get());
	}
	return 0;
}
```

## src/link.c
```c
#include <errno.h>

#include <plant/net.h>

#include "link.h"

void link_init(struct link *l, const struct link_config *cfg)
{
	*l = (struct link){.cfg = cfg};
}

static void sntp_once(struct link *l)
{
	int64_t epoch_ms;

	if (l->sntp_attempted) {
		return;
	}
	l->sntp_attempted = true;
	if (plant_sntp_sync(l->cfg->sntp_timeout_ms, &epoch_ms) == 0) {
		l->boot_epoch_ms = epoch_ms - link_uptime_ms();
		l->have_epoch = true;
	}
}

bool link_wall_clock_ms(const struct link *l, int64_t uptime_ms, int64_t *wall_ms)
{
	if (!l->have_epoch) {
		return false;
	}
	*wall_ms = l->boot_epoch_ms + uptime_ms;
	return true;
}

int link_try_up(struct link *l)
{
	const struct link_config *cfg = l->cfg;
	int16_t rssi;
	int ret;

	if (!l->associated_once || plant_wifi_rssi(&rssi) == -ENOTCONN) {
		ret = plant_wifi_connect(cfg->ssid, cfg->psk, cfg->wifi_timeout_ms);
		if (ret < 0) {
			return ret;
		}
		l->associated_once = true;
		sntp_once(l);
	}
	/* A failed publish can leave plant_net's client marked connected, and
	 * plant_mqtt_connect() would then answer -EALREADY on every retry.
	 * Releasing it first is harmless when it is already closed. */
	(void)plant_mqtt_disconnect();
	return plant_mqtt_connect(cfg->broker, cfg->client_id, cfg->mqtt_timeout_ms);
}
```

## src/link.h
```c
/* Connection recovery of comparison baseline A (FR-AW-01.2-3, FR-AW-04).
 *
 * Zephyr-free so the host tests can run it (tests/host/test_active_wifi.c):
 * it reaches the network only through <plant/net.h>, and the clock only
 * through link_uptime_ms(), which the app provides. */
#ifndef ACTIVE_WIFI_LINK_H
#define ACTIVE_WIFI_LINK_H

#include <stdbool.h>
#include <stdint.h>

struct link_config {
	const char *ssid;
	const char *psk;
	const char *broker;
	const char *client_id;
	int32_t wifi_timeout_ms;
	int32_t mqtt_timeout_ms;
	int32_t sntp_timeout_ms;
};

struct link {
	const struct link_config *cfg;
	bool associated_once;
	bool sntp_attempted;
	bool have_epoch;
	int64_t boot_epoch_ms;
};

/* Milliseconds since boot. Provided by the app (k_uptime_get()). */
int64_t link_uptime_ms(void);

void link_init(struct link *l, const struct link_config *cfg);

/* One attempt to bring the MQTT connection up, used at boot and after every
 * drop. Connects WiFi first until it has associated once; after that,
 * reassociates first only when plant_wifi_rssi() reports -ENOTCONN, and
 * otherwise reconnects MQTT alone. The single SNTP attempt per boot happens
 * right after the first successful association. Returns 0 when MQTT is
 * connected, or the error of the step that failed. The caller retries at
 * once: no backoff, no sleep. */
int link_try_up(struct link *l);

/* Wall-clock time (ms since the Unix epoch) at the given uptime, from the
 * boot's SNTP sync. false while no sync has succeeded (timestamp_ms null). */
bool link_wall_clock_ms(const struct link *l, int64_t uptime_ms, int64_t *wall_ms);

#endif
```

## src/slot.h
```c
/* Publication grid of comparison baseline A (FR-AW-03, FR-AW-04).
 * Zephyr-free so the host tests can run it (tests/host/test_active_wifi.c). */
#ifndef ACTIVE_WIFI_SLOT_H
#define ACTIVE_WIFI_SLOT_H

#include <stdint.h>

/* Slot k is due at t0_ms + k * interval_ms, and its cycle_count is k.
 * Returns the first slot >= min_slot that is not late at now_ms (due >= now).
 * A slot that fell due during an overrun or an outage is skipped but still
 * counted, so the firmware never publishes late and the gap in cycle_count
 * equals the outage in intervals. now_ms must not be before t0_ms. */
static inline uint32_t slot_next(int64_t t0_ms, int64_t interval_ms, uint32_t min_slot,
				 int64_t now_ms)
{
	uint32_t first_on_time = (uint32_t)((now_ms - t0_ms + interval_ms - 1) / interval_ms);

	return (first_on_time > min_slot) ? first_on_time : min_slot;
}

#endif
```
