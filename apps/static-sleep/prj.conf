## CMakeLists.txt
```
cmake_minimum_required(VERSION 3.20)
find_package(Zephyr REQUIRED HINTS $ENV{ZEPHYR_BASE})
project(static-sleep)
target_sources(app PRIVATE src/main.c)
```

## prj.conf
```kconfig
CONFIG_WIFI=n
CONFIG_BT=n
CONFIG_LOG=n
CONFIG_CONSOLE=n
CONFIG_UART_CONSOLE=n
CONFIG_POWEROFF=y
```

## validate.conf
```kconfig
# TEMPORARY — validation only. Do NOT measure I_sleep with this file in the build.
# Re-enables a console on the native USB-Serial/JTAG so the printk in main.c is
# visible on /dev/ttyACM0. Remove (rebuild without -DEXTRA_CONF_FILE) before measuring.
CONFIG_SERIAL=y
CONFIG_CONSOLE=y
CONFIG_UART_CONSOLE=y
CONFIG_SERIAL_ESP32_USB=y
```

## validate.overlay
```dts
/* TEMPORARY — validation only. Routes the console to the native USB-Serial/JTAG
 * (the same port you flash over, /dev/ttyACM0). Remove before measuring I_sleep. */
/ {
	chosen {
		zephyr,console = &usb_serial;
	};
};

&usb_serial {
	status = "okay";
};
```

## src/main.c
```c
#include <zephyr/sys/poweroff.h>

int main(void)
{
    /* Deep sleep with no wake source: stays down until an external reset. */
    sys_poweroff();
    return 0;
}
```
